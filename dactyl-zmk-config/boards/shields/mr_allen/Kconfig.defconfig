## dactyl-zmk-config/boards/shields/mr_allen/Kconfig.defconfig
```kconfig
if SHIELD_MR_ALLEN_LEFT

config ZMK_SPLIT_ROLE_CENTRAL
    default y

endif

if SHIELD_MR_ALLEN_LEFT || SHIELD_MR_ALLEN_RIGHT

config ZMK_KEYBOARD_NAME
    default "Mr. Allen"

config ZMK_SPLIT
    default y

endif
```

## dactyl-zmk-config/boards/shields/mr_allen/Kconfig.shield
```kconfig
config SHIELD_MR_ALLEN_LEFT
    def_bool $(shields_list_contains,mr_allen_left)

config SHIELD_MR_ALLEN_RIGHT
    def_bool $(shields_list_contains,mr_allen_right)
```
